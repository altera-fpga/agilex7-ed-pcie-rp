## src/sw/meta-altera-pcie-rp/conf/layer.conf
```bitbake
# We have a conf and classes directory, add to BBPATH
BBPATH .= ":${LAYERDIR}"

# We have recipes-* directories, add to BBFILES
BBFILES:append = " ${LAYERDIR}/recipes*/*/*.bb ${LAYERDIR}/recipes*/*/*.bbappend"

BBFILE_COLLECTIONS:append = " meta-altr-rped"
BBFILE_PATTERN_meta-altr-rped = "^${LAYERDIR}/"
BBFILE_PRIORITY_meta-altr-rped = "6"

LAYERSERIES_COMPAT_meta-altr-rped = "master scarthgap"
```
